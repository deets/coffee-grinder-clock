## main/Kconfig
```kconfig
config COFFEE_CLOCK_STREAM_DATA
   bool "Stream the data using WIFI"
   default n
   help
      If defined, pull in the 

config COFFEE_CLOCK_FILTER_IMU
   bool "Filter IMU data using Madgwick"
   default n
   help
      If defined, we run the IMU data through a Madgwick filter
```
